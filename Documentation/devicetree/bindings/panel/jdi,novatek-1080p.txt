## Documentation/devicetree/bindings/panel/jdi,novatek-1080p.txt
```
Japan Display Inc. 1080x1920 DSI panel (Novatek IC)

This panel supports both video and command mode (although currently only video
mode is implemented in the driver.

Required properties:
- compatible: should be "jdi,novatek-1080p-vid"

Optional properties:
- power-supply: phandle of the regulator that provides the supply voltage
- reset-gpio: phandle of gpio for reset line
- backlight: phandle of the backlight device attached to the panel

Example:
	dsi@54300000 {
		panel: panel@0 {
			compatible = "jdi,novatek-1080p-vid";
			reg = <0>;

			power-supply = <...>;
			reset-gpio = <...>;
			backlight = <...>;
		};
	};
```

## Documentation/devicetree/bindings/phy/qcom-qmp-phy.txt
```
Qualcomm QMP PHY
----------------

QMP phy controller supports physical layer functionality for a number of
controllers on Qualcomm chipsets, such as, PCIe, UFS, and USB.

Required properties:
 - compatible: compatible list, contains:
	       "qcom,msm8996-qmp-pcie-phy" for 14nm PCIe phy on msm8996,
	       "qcom,msm8996-qmp-usb3-phy" for 14nm USB3 phy on msm8996.
 - reg: offset and length of the PHY register set.
 - #phy-cells: must be 1
    - Cell after phy phandle should be the port (lane) number.
 - clocks: a list of phandles and clock-specifier pairs,
	   one for each entry in clock-names.
 - clock-names: must be "cfg_ahb" for phy config clock,
			"aux" for phy aux clock,
			"ref_clk" for 19.2 MHz ref clk,
			"ref_clk_src" for reference clock source,
			"pipe<port-number>" for pipe clock specific to
			each port/lane (Optional).
 - resets: a list of phandles and reset controller specifier pairs,
	   one for each entry in reset-names.
 - reset-names: must be "phy" for reset of phy block,
			"common" for phy common block reset,
			"cfg" for phy's ahb cfg block reset (Optional).
			"port<port-number>" for reset specific to
			each port/lane. (Optional)
 - vdda-phy-supply: Phandle to a regulator supply to PHY core block.
 - vdda-pll-supply: Phandle to 1.8V regulator supply to PHY refclk pll block.

Optional properties:
 - vddp-ref-clk-supply: Phandle to a regulator supply to any specific refclk
			pll block.

Example:
	pcie_phy: pciephy@34000 {
		compatible = "qcom,qmp-14nm-pcie-phy";
		reg = <0x034000 0x3fff>;
		#phy-cells = <1>;

		clocks = <&gcc GCC_PCIE_PHY_AUX_CLK>,
			<&gcc GCC_PCIE_PHY_CFG_AHB_CLK>,
			<&gcc GCC_PCIE_0_PIPE_CLK>,
			<&gcc GCC_PCIE_1_PIPE_CLK>,
			<&gcc GCC_PCIE_2_PIPE_CLK>;
		clock-names = "aux", "cfg_ahb",
				"pipe0", "pipe1", "pipe2";

		vdda-phy-supply = <&pm8994_l28>;
		vdda-pll-supply = <&pm8994_l12>;

		resets = <&gcc GCC_PCIE_PHY_BCR>,
			<&gcc GCC_PCIE_PHY_COM_BCR>,
			<&gcc GCC_PCIE_PHY_COM_NOCSR_BCR>,
			<&gcc GCC_PCIE_0_PHY_BCR>,
			<&gcc GCC_PCIE_1_PHY_BCR>,
			<&gcc GCC_PCIE_2_PHY_BCR>;
		reset-names = "phy", "common", "cfg",
				"lane0", "lane1", "lane2";
	};
```

## Documentation/devicetree/bindings/phy/qcom-qusb2-phy.txt
```
Qualcomm QUSB2 phy controller
=============================

QUSB2 controller supports LS/FS/HS usb connectivity on Qualcomm chipsets.

Required properties:
 - compatible: compatible list, contains "qcom,msm8996-qusb2-phy".
 - reg: offset and length of the PHY register set.
 - #phy-cells: must be 0.

 - clocks: a list of phandles and clock-specifier pairs,
	   one for each entry in clock-names.
 - clock-names: must be "cfg_ahb" for phy config clock,
			"ref_clk" for 19.2 MHz ref clk,
			"ref_clk_src" reference clock source.
			"iface" for phy interface clock (Optional).

 - vdd-phy-supply: Phandle to a regulator supply to PHY core block.
 - vdda-pll-supply: Phandle to 1.8V regulator supply to PHY refclk pll block.
 - vdda-phy-dpdm: Phandle to 3.1V regulator supply to Dp/Dm port signals.

 - resets: a list of phandles and reset controller specifier pairs,
	   one for each entry in reset-names.
 - reset-names: must be "phy" for reset of phy block.

Optional properties:
 - nvmem-cells: a list of phandles to nvmem cells that contain fused
		tuning parameters for qusb2 phy, one for each entry
		in nvmem-cell-names.
 - nvmem-cell-names: must be "tune2_hstx_trim_efuse" for cell containing
		     HS Tx trim value.
 - qcom,hstx-trim-bit-offset: bit offset within nvmem cell for
			      HS Tx trim value.
 - qcom,hstx-trim-bit-len: bit length of HS Tx trim value within nvmem cell.

 - qcom,tcsr-syscon: Phandle to TCSR syscon register region.
 - qcom,phy-clk-scheme: Offset to TCSR_PHY_CLK_SCHEME_SEL register.
```

## drivers/net/qrtr/Kconfig
```kconfig
# Qualcomm IPC router configuration
#

config QRTR
	bool "Qualcomm IPC router support"
	---help---
	  Say Y if you intend to use Qualcomm IPC router protocol.

if QRTR

config QRTR_SMD
	tristate "SMD IPC router channels"
	depends on QRTR
	---help---
	  Say Y here to support SMD based ipcrouter channels.

endif # QRTR
```

## drivers/sensor/Kconfig
```kconfig
#
# Sensor  drivers configuration
#
menuconfig SENSORS_CORE
	bool "Sensor devices"
	help
	  Say Y here, and a list of sensors drivers will be displayed.
	  Everything that didn't fit into the other categories is here. This option
	  doesn't affect the kernel.

	  If unsure, say Y.

if SENSORS_CORE

config SENSORS_L3GD20
	depends on I2C
	tristate "STMicro Gyro L3GD20 driver"
	default n
	help
	  Driver for STMicro Gyro L3GD20

config SENSORS_LSM303DLHC
	tristate "ST LSM303DLHC 3-axis accelerometer and 3-axis magnetometer"
	depends on I2C
	default n
	help
	  This driver provides support for the LSM303DLHC chip which includes a
	  3-axis accelerometer and a 3-axis magnetometer.

	  This driver can also be built as modules.  If so, the module for
	  accelerometer will be called lsm303dlhc_a and for magnetometer it will
	  be called lsm303dlhc_m.

	  Say Y here if you have a device containing lsm303dlhc chip.


config SENSORS_LSM303DLHC_INPUT_DEVICE
	bool "ST LSM303DLHC INPUT DEVICE"
	depends on SENSORS_LSM303DLHC
	default n
	help
	  This driver allows device to be used as an input device with
	  interrupts, need to be enabled only when input device support
	  is required.


config SENSORS_LPS331
	tristate "STMicro LPS331 driver"
	default n
	depends on I2C
	help
	  Driver for STMicro LPS331
endif
```

## drivers/staging/trapz/Kconfig
```kconfig
config TRAPZ
	bool "Tracing and Profiling for Zpeed"
	default n

config TRAPZ_TP
	bool "Globally enable trapz trace points in kernel"
	default n
	depends on TRAPZ
	help
		This enables trapz tracepoints. If this is disabled
		and CONFIG_TRAPZ is enabled, userspace trapz tracing
		is still functional.

config TRAPZ_TRIGGER
	bool "Include ability to trigger events based on latency"
	default n
	depends on TRAPZ
	help
		This feature issues uevents if a trigger is fired.  The uevents can then
		be trapped in user space to react
```

## net/bluetooth/hidp/Kconfig
```kconfig
config BT_HIDP
	tristate "HIDP protocol support"
	depends on INPUT && HID_SUPPORT
	select HID
	select BT
	help
	  HIDP (Human Interface Device Protocol) is a transport layer
	  for HID reports.  HIDP is required for the Bluetooth Human
	  Interface Device Profile.

	  Say Y here to compile HIDP support into the kernel or say M to
	  compile it as module (hidp).
```
